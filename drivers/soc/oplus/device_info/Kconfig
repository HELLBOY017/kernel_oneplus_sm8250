## oplus/kernel/system/oplus_ordump/Kconfig
```kconfig
# SPDX-License-Identifier: GPL-2.0-only
# Copyright (C) 2018-2020 Oplus. All rights reserved.
config OPLUS_FEATURE_FULLDUMP_BACK
    tristate "OPLUS-FULLDUMP_BACK support"
    default n
    help
      OPLUS-FULLDUMP_BACK is the kernel config of ORDUMP feature
      ORDUMP (Memory RAM Dump) based on OPLUS-FULLDUMP_BACK is designed as a memory
      dump mechanism for debugging system to dump DRAM content at QCOM
      android phone platform
```

## oplus/kernel/wakelock_profiler/Kconfig
```kconfig
#code deprecated ... start (Todo : delete this code section)
#ifdef OPLUS_FEATURE_POWERINFO_STANDBY
config OPLUS_WAKELOCK_PROFILER
bool "config oplus wakelock profiler"
help
    Select this config to enable oplus wakelock profiler
#endif /* OPLUS_FEATURE_POWERINFO_STANDBY */

#ifdef OPLUS_FEATURE_POWERINFO_STANDBY
config OPLUS_POWER_QCOM
bool "QCOM Config"
help
    Select this config to enable oplus wakelock profiler
#endif /* OPLUS_FEATURE_POWERINFO_STANDBY */

#ifdef OPLUS_FEATURE_POWERINFO_STANDBY
config OPLUS_POWER_MTK
bool "MTK Config"
help
    Select this config to enable oplus wakelock profiler
#endif /* OPLUS_FEATURE_POWERINFO_STANDBY */
#code deprecated ... end (Todo : delete this code section)



#ifdef OPLUS_FEATURE_POWERINFO_STANDBY
config OPLUS_WAKELOCK_PROFILER
bool "config wakelock profiler"
help
    Select this config to enable wakelock profiler

config OPLUS_POWER_QCOM
bool "QCOM Config"
help
    Select this config to enable wakelock profiler

config OPLUS_POWER_MTK
bool "MTK Config"
help
    Select this config to enable wakelock profiler
#endif /* OPLUS_FEATURE_POWERINFO_STANDBY */

#ifdef OPLUS_FEATURE_POWERINFO_STANDBY_DEBUG
config OPLUS_POWERINFO_STANDBY_DEBUG
bool "powerinfo standby config"
default n
help
    Select this config to enable powerinfo standby debug
#endif /* OPLUS_FEATURE_POWERINFO_STANDBY_DEBUG */

#ifdef OPLUS_FEATURE_POWERINFO_RPMH
config OPLUS_POWERINFO_RPMH
bool "powerinfo rpmh config"
default n
help
    Select this config to enable powerinfo rpmh
#endif /* OPLUS_FEATURE_POWERINFO_RPMH */

#ifdef OPLUS_FEATURE_POWERINFO_FTM
config OPLUS_POWERINFO_FTM
bool "powerinfo ftm config"
default n
help
    Select this config to enable powerinfo ftm
#endif /* OPLUS_FEATURE_POWERINFO_FTM */
```
