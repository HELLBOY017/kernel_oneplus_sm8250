## drivers/soc/oplus/device_info/Kconfig
```kconfig
config OPLUS_DEVICE_INFO
  bool "config oplus devinfo software"
  help
    define this config to compile devinfo.c for device register
```

## drivers/soc/oplus/system/Kconfig
```kconfig
# SPDX-License-Identifier: GPL-2.0-only
# Copyright (C) 2018-2020 Oplus. All rights reserved.

config OPLUS_SYSTEM_KERNEL
  bool "config oplus system feature "
  default y
  help
	define this config to add oplus sytstem kernel feature

config OPLUS_BUG_STABILITY
  tristate "Config stability bug fixing effect"
  help
        Define this config to fix stability bugs

config OPLUS_BUG_STABILITY_EFFECTON_QGKI
  tristate "config stability bug fixing effect on qgki"
  help
	define this config to fix stability bug only effect on qgki

source "drivers/soc/oplus/system/feedback/Kconfig"
source "drivers/soc/oplus/system/oplus_project/Kconfig"
source "drivers/soc/oplus/system/project_info/Kconfig"
source "drivers/soc/oplus/system/cmdline_parser/Kconfig"
source "drivers/soc/oplus/system/oplus_mm_fb/Kconfig"
source "drivers/soc/oplus/system/param/Kconfig"
```

## drivers/soc/oplus/system/param/Kconfig
```kconfig
# SPDX-License-Identifier: GPL-2.0-only
# Copyright (C) 2018-2020 Oplus. All rights reserved.

config OPLUS_PARAM_READ_WRITE
	bool "Param partition read/write support"
	default n
	help
	if you want to read/write the param partition in kernel,
	then you must say Y here.
```

## oplus/kernel/charger/v2/Kconfig
```kconfig
source "$(KCONFIG_EXT_PREFIX)drivers/power/oplus/v2/ufcs/Kconfig"

config OPLUS_CHG_IC_DEBUG
	bool "Virtual IC layer debug interface"
	help
	  Say Y here to declare virtual IC layer debug interface

config OPLUS_CHG_MMS_DEBUG
	bool "Message subscription layer debug interface"
	help
	  Say Y here to declare message subscription layer debug interface

config OPLUS_SMART_CHARGE
	bool "smart charge"
	help
	  Say Y here to enable smart charge

config OPLUS_DA9313_CHARGER
	bool "DA9313 support"
	help
	  Say Y here to declare DA9313 support

config OPLUS_MP2762_CHARGER
	bool "MP2762 support"
	help
	  Say Y here to declare MP2762 support

config OPLUS_SGM41512_CHARGER
	bool "SGM41512 support"
	help
	  Say Y here to declare SGM41512 support

config OPLUS_PD_MANAGER_CHARGER
	bool "PD_MANAGER support"
	help
	  Say Y here to declare PD_MANAGER support

config OPLUS_ADSP_CHARGER
	bool "ADSP support"
	help
	  Say Y here to declare ADSP support

config OPLUS_MT6375_CHARGER
	bool "MT6375 debug support"
	help
	  Say Y here to declare MT6375 debug support

config OPLUS_ADSP_SM8450_CHARGER
	bool "SM8450 support"
	help
	  Say Y here to declare sm8450 support

config OPLUS_CHG_PARALLEL
	bool "parallel battery switching support"
	help
	  Say Y here to declare parallel battery switching support

config OPLUS_CHG_MOS_CTRL
	bool "parallel mos ctrl support"
	help
	  Say Y here to declare parallel mos ctrl support

config OPLUS_VOOCPHY_SC8547A
	bool "oplus voocphy sc8547a support"
	help
	  Say Y here to declare cp sc8547a support


config OPLUS_UFCS_SC2201
	bool "enable sc2201 ufcs phy"
	depends on OPLUS_UFCS_CLASS
	help
	  Say Y here to declare sc2201 ufcs phy support

config OPLUS_UFCS_SC8547A
	bool "enable sc8547a ufcs phy"
	depends on OPLUS_UFCS_CLASS && !OPLUS_VOOCPHY_SC8547A
	help
	  Say Y here to declare sc8547a ufcs phy support

config OPLUS_WIRELESS_NU1619
	bool "oplus wireless nu1619 support"
	help
	  Say Y here to declare wireless nu1619 support

config OPLUS_WIRELESS_P9415
	bool "oplus wireless p9415 support"
	help
	  Say Y here to declare wireless p9415 support

config OPLUS_CHARGEPUMP_HL7227
	bool "oplus chargepump hl7227 support"
	help
	  Say Y here to declare chargepump hl7227 support

menuconfig OPLUS_CHG_VOOCPHY
	bool "OPLUS charging voocphy"
	help
	  Say Y here to enable OPLUS charging system support

if OPLUS_CHG_VOOCPHY
config OPLUS_CHG_VOOCPHY_CHGLIB
	bool "voocphy chglib support"
	help
	  Say Y here to declare voocphy chglib support

config OPLUS_CHG_AP_VOOCPHY
	bool "ap voocphy support"
	depends on OPLUS_CHG_VOOCPHY_CHGLIB
	help
          Say Y here to declare ap voocphy support

config OPLUS_CHG_ADSP_VOOCPHY
	bool "adsp voocphy support"
	depends on OPLUS_CHG_VOOCPHY_CHGLIB
	help
          Say Y here to declare adsp voocphy support

config OPLUS_VOOCPHY_MASTER_SC8547
	bool "master cp sc8547 support"
	depends on OPLUS_CHG_VOOCPHY_CHGLIB && OPLUS_CHG_AP_VOOCPHY
	help
	  Say Y here to declare master cp sc8547 support

config OPLUS_VOOCPHY_SLAVE_SC8547
	bool "slave cp sc8547 support"
	depends on OPLUS_CHG_VOOCPHY_CHGLIB && OPLUS_CHG_AP_VOOCPHY
	help
	  Say Y here to declare slave cp sc8547 support

config OPLUS_VOOCPHY_SC8517
	bool "bidirect cp sc8517 support"
	depends on OPLUS_CHG_VOOCPHY_CHGLIB && OPLUS_CHG_AP_VOOCPHY
	help
	  Say Y here to declare bidirect cp sc8517 support

config OPLUS_AUDIO_SWITCH_GLINK
	bool "audio switch glink support"
	help
	  Say Y here to declare audio switch glink support

config OPLUS_VOOCPHY_HL7138
	bool "cp hl7138 support"
	depends on OPLUS_CHG_VOOCPHY_CHGLIB && OPLUS_CHG_AP_VOOCPHY
	help
	  Say Y here to declare cp hl7138 support

endif #OPLUS_CHG_VOOCPHY
```

## oplus/kernel/charger/v2/ufcs/Kconfig
```kconfig
config OPLUS_UFCS_CLASS
	tristate "oplus ufcs class"
	default n
	help
	  Say Y or M to enable oplus ufcs class
```

## oplus/kernel/network/data_module/Kconfig
```kconfig
# SPDX-License-Identifier: GPL-2.0-only
# Copyright (C) 2020-2022 Oplus. All rights reserved.

config OPLUS_FEATURE_DATA_MODULE
        tristate "Add for data modules"
        help
          Add for data modules.
```

## oplus/kernel/network/oplus_network_tuning/Kconfig
```kconfig
# SPDX-License-Identifier: GPL-2.0-only
# Copyright (C) 2020-2022 Oplus. All rights reserved.

config OPLUS_FEATURE_NETWORK_KERNEL
        tristate "Add for network parameter"
        help
          Add for Add for network parameter.
```

## oplus/kernel/network/oplus_socket_stats_report/Kconfig
```kconfig
# SPDX-License-Identifier: GPL-2.0-only
# Copyright (C) 2020-2022 Oplus. All rights reserved.

config OPLUS_FEATURE_ESTABLISH_REPORT
        tristate "ESTABLISH REPORT"
        help
          If you say yes to this option, will report establish
          event to users space
```

## oplus/kernel/network/oplus_vnet/Kconfig
```kconfig
# PDX-License-Identifier: GPL-2.0-only
# Copyright (C) 2020-2022 Oplus. All rights reserved.

config OPLUS_FEATURE_VIRTUAL_NET
        tristate "Add for virtual net device for datashare"
        help
          Add for virtual net device for datashare
```

## oplus/kernel/oplus_performance/frame_boost/Kconfig
```kconfig
config OPLUS_FEATURE_FRAME_BOOST
	bool "config frame boost3.0"
	default n
	depends on SCHED_WALT
	help
		track key thread information during frame drawing, opt task placement and frequency selection
```

## oplus/kernel/oplus_performance/sched_assist/Kconfig
```kconfig
config OPLUS_FEATURE_SCHED_ASSIST
	tristate "sched_assist"
	default n
	help
	  turning sched for ui, render and so on to improve UX
config OPLUS_FEATURE_SCHED_SPREAD
	bool "sched_spread"
	default n
	help
	  This is the uifirst 5.0 feature, which will spread tasks,
	  kick runnable time from task demand and adjust bg's time slice.
config OPLUS_FEATURE_SCHED_UX_PRIORITY
	bool "sched_ux_priority"
	default n
	depends on OPLUS_FEATURE_SCHED_ASSIST
	help
	  enable ux list and ux priority for cfs task, ported from kernel 5.10
config OPLUS_UX_IM_FLAG
	bool "config ux im_flag"
	default n
	help
	  export im_flag proc node for mark thread.
config OPLUS_RELEASE_BUFFER_CALLBACK_UX
	bool "config launcher async release buffer callback ux"
	default n
	help
	  the binder thread of launcher which response async release buffer
	  callback from sf is set to UX from ONCE_UX.
config OPLUS_FEATURE_AUDIO_OPT
	bool "config audio opt"
	default n
	help
	  audio task schedule opt.
config OPLUS_FEATURE_AUDIO_CAMUX_OFF
        bool "config audio scene camera ux off"
        default n
        help
          camera provider preempt audio thread, turn off camera ux in audio
          scene.
config OPLUS_CRTC_COMMIT_MUTEX_OPT
	bool "config crtc_commit mutex opt"
	default n
	help
	  crtc_commit thread and CFS thread frequently compete for mutex
	  lock optimization.

config OPLUS_SS_LOCKER_OPT
	bool "config system_server locker optimation"
	default n
	help
	  when ams/wms using synchronized(), it will be marked as ss_locker,
	  adjust it's thread priority and do preempt-protection if
	  CONFIG_LOCKING_PROTECT is set.

config OPLUS_LOCKING_STRATEGY
	bool "config monitor&juc locking optimation"
	depends on OPLUS_FEATURE_SCHED_ASSIST
	default n
	help
	  monitor&juc locking optimation.

config OPLUS_CPU_AUDIO_PERF
	tristate "boost audio task in scheduler"
	default n
	depends on OPLUS_UX_IM_FLAG
	help
	   Choose this option to enable scheduler boost for audio task.

config OPLUS_LOCKING_OSQ
	bool "osq control"
	depends on OPLUS_LOCKING_STRATEGY
	default n
	help
	  Customized mutex & rwsem osq logic.

config OPLUS_LOCKING_MONITOR
	bool "locking stats monitor"
	depends on OPLUS_LOCKING_STRATEGY
	default n
	help
	  Tracing kernel-lock statistics.

config OPLUS_INTERNAL_VERSION
	bool "internal version"
	depends on OPLUS_LOCKING_MONITOR
	default n
	help
	  Support more tracing-types in internal version.
config OPLUS_FEATURE_EAS_OPT
	tristate "eas opt"
	default n
	help
	  control oplus_cap, iowait_protect

config OPLUS_FEATURE_VT_CAP
	tristate "oplus cap"
	default n
	depends on OPLUS_FEATURE_EAS_OPT
	help
	  oplus cap can influence task placement

config OPLUS_CPUFREQ_IOWAIT_PROTECT
	tristate "cpufreq_iowait"
	default n
	depends on OPLUS_FEATURE_EAS_OPT
	help
	  ensure iowait decay not happen too quickly
```

## oplus/kernel/oplus_performance/sigkill_diagnosis/Kconfig
```kconfig
# SPDX-License-Identifier: GPL-2.0-only
# Copyright (C) 2018-2020 Oplus. All rights reserved.

config OPLUS_FEATURE_SIGKILL_DIAGNOSIS
	tristate "sigkill diagnosis driver"
	default n
	help
	  assist sigkill diagnosis. record kill reason category for athena
```

## oplus/kernel/oplus_performance/tmemory/Kconfig
```kconfig
config TMEMORY
	tristate "tmemory module"
	depends on BLOCK
	default n
	help
	  Support tmemory

config TMEMORY_CRYPTO
	bool "tmemory crypto"
	depends on TMEMORY
	depends on BLK_INLINE_ENCRYPTION
	default n
	help
	  enable tmemory crypto

config TMEMORY_DEBUG
	bool "tmemory debug"
	depends on TMEMORY
	default n
	help
	  use tmemory debug log

config TMEMORY_MIGRATION
	bool "tmemory page migration"
	depends on TMEMORY
	depends on TMEMORY_CRYPTO
	default n
	help
	  support page migration

config TMEMORY_SWITCH_TIME_DEFAULT
	int "tmemory switch time's default value"
	depends on TMEMORY
	default "5000"
	help
	  new bio will be blocked after this time.

config TMEMORY_FAULT_INJECTION
	bool "tmemory fault injection"
	depends on TMEMORY
	default n
	help
	  support fault injection

config TMEMORY_PANIC_NOCLOSE
	bool "tmemory panic noclose"
	depends on TMEMORY
	default n
	help
	  support when panic tmemory not to close
```

## oplus/kernel/oplus_performance/uad/Kconfig
```kconfig
config OPLUS_CPU_FREQ_GOV_UAG
	tristate "uag cpufreq policy governor"
	depends on CPU_FREQ && SMP
	select CPU_FREQ_GOV_ATTR_SET
	select IRQ_WORK
	help
	  This governor makes decisions based on the utilization.  It sets
          the CPU frequency to be proportional to the utilization/capacity
          ratio coming from the scheduler or frameboost.  If the utilization
          is frequency-invariant, the new frequency is also proportional to
          the maximum available frequency.  If that is not the case, it is
          proportional to the current frequency of the CPU.

	  If in doubt, say N.

config UAG_NONLINEAR_FREQ_CTL
	bool "Non-linear frequency control"
	depends on OPLUS_CPU_FREQ_GOV_UAG
	default n
	help
	  Choose this option to enable non-linear frequency control.
	  This will change per-opp capacity from linear scaled by
	  freuqency to evaluated by benchmark. This makes capacity
	  more accurate and will let scheduler/schedutil use more
	  suitable frequency.

config OPLUS_UAG_USE_TL
	bool "use target loads in uag cpufreq policy governor"
	depends on OPLUS_CPU_FREQ_GOV_UAG
	default n
	help
	  Add target_loads sysfs attr in uag cpufreq policy governor.

config UA_KERNEL_CPU_IOCTL
	tristate "cpu ioctl interface"
	default n
	help
	  Provide ioctl interface for cpu features.

config OPLUS_UAG_AMU_AWARE
	bool "consider amu info for cpufreq decision"
	depends on OPLUS_CPU_FREQ_GOV_UAG
	default n
	help
	  Consider AMU info such as cycles/stall ... to adjust cpufreq.

config OPLUS_MULTI_LV_TL
	bool "Add multi-level target loads to scale cpu frequency"
	depends on OPLUS_UAG_USE_TL && UAG_NONLINEAR_FREQ_CTL && OPLUS_FEATURE_FRAME_BOOST
	default n
	help
	  Add multi-level target loads to scale cpu frequency.

config OPLUS_FEATURE_TOUCH_BOOST
	tristate "touch_boost"
	default n
	help
	  oplus touch boost

config OPLUS_UAG_SOFT_LIMIT
	bool "soft frequency limit in uag cpufreq policy governor"
	depends on OPLUS_CPU_FREQ_GOV_UAG
	default n
	help
	  Add soft frequency limit in uag cpufreq policy governor.
	  Frequency can breakthrough this limit in UA scene.
```

## oplus/kernel/power/subsys_sleep_monitor/Kconfig
```kconfig
config OPLUS_SUBSYS_SLEEP_MONITOR
	tristate "monitor Qualcomm subsystem sleep"
	default n
	help
	  This selects to get sleep info for Qualcomm subsystem
```

## oplus/kernel/storage/Kconfig
```kconfig
config OPLUS_FEATURE_STORAGE_IO_METRICS
	tristate "config storage io metrics"
	default y
	help
	  The function of this module is to collect various metrics on the IO path

source "drivers/soc/oplus/storage/common/fmonitor/Kconfig"
```

## oplus/kernel/storage/common/fmonitor/Kconfig
```kconfig
config OPLUS_FEATURE_FILE_MONITOR
    tristate "file monitor"
    default y
    help
      Monitor User Mode File Modification.
```

## oplus/kernel/storage/storage_feature_in_module/Kconfig
```kconfig
source "drivers/soc/oplus/storage/common/storage_log/Kconfig"
source "drivers/soc/oplus/storage/common/oplus_uprobe/Kconfig"
```

## oplus/kernel/storage/storage_feature_in_module/common/oplus_uprobe/Kconfig
```kconfig
config OPLUS_FEATURE_OPLUS_UPROBE
    tristate "oplus uprobe"
    default n
    help
      define this config to enable oplus uprobe feature.
```

## oplus/kernel/storage/storage_feature_in_module/common/storage_log/Kconfig
```kconfig
config OPLUS_FEATURE_STORAGE_LOG
   tristate "config storage log"
   default n
   help
     General Configuration of Storage Log
```

## oplus/kernel/system/init_watchdog/Kconfig
```kconfig
# SPDX-License-Identifier: GPL-2.0-only
# Copyright (C) 2022-2030 Oplus. All rights reserved.
config OPLUS_FEATURE_INIT_WATCHDOG
    tristate "init watchdog"
    default n
    help
      define this config to enable init watchdog monitor feature.
```

## oplus/kernel/system/last_boot_reason/Kconfig
```kconfig
# SPDX-License-Identifier: GPL-2.0-only
# Copyright (C) 2018-2020 Oplus. All rights reserved.
config OPLUS_FEATURE_LAST_BOOT_REASON
    tristate "last boot reason"
    default y
    help
            define this config to enable last_boot_reason.
```

## oplus/kernel/system/mdmfeature/Kconfig
```kconfig
# SPDX-License-Identifier: GPL-2.0-only
# Copyright (C) 2018-2020 Oplus. All rights reserved.
config OPLUS_FEATURE_MDMFEATURE
  tristate "config modify modem feature"
  default n
  help
    define this config to modify modem feature.

config OPLUS_FEATURE_QCOM_SMEM_INTI
  bool "config init smem on qcom"
  default n
  help
    This config only be used on qcom platform.
```
